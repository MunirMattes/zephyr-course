## boards/my_board/Kconfig.defconfig
```kconfig
config BOARD_MY_BOARD
	select BOARD_EARLY_INIT_HOOK
	select BOARD_LATE_INIT_HOOK
```

## boards/my_board/my_board_defconfig
```kconfig
CONFIG_CONSOLE=y
CONFIG_UART_CONSOLE=y
CONFIG_SERIAL=y
CONFIG_UART_INTERRUPT_DRIVEN=y

# Enable TrustZone-M
CONFIG_TRUSTED_EXECUTION_SECURE=y
```
